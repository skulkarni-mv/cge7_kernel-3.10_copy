## drivers/staging/bcmdrivers/nand/Kconfig
```kconfig
#
# Copyright (C) 2013, Broadcom Corporation. All Rights Reserved.
# 
# Permission to use, copy, modify, and/or distribute this software for any
# purpose with or without fee is hereby granted, provided that the above
# copyright notice and this permission notice appear in all copies.
# 
# THE SOFTWARE IS PROVIDED "AS IS" AND THE AUTHOR DISCLAIMS ALL WARRANTIES
# WITH REGARD TO THIS SOFTWARE INCLUDING ALL IMPLIED WARRANTIES OF
# MERCHANTABILITY AND FITNESS. IN NO EVENT SHALL THE AUTHOR BE LIABLE FOR ANY
# SPECIAL, DIRECT, INDIRECT, OR CONSEQUENTIAL DAMAGES OR ANY DAMAGES
# WHATSOEVER RESULTING FROM LOSS OF USE, DATA OR PROFITS, WHETHER IN AN ACTION
# OF CONTRACT, NEGLIGENCE OR OTHER TORTIOUS ACTION, ARISING OUT OF OR IN
# CONNECTION WITH THE USE OR PERFORMANCE OF THIS SOFTWARE.
#
menuconfig IPROC_MTD_NAND
	tristate "NAND support"
	depends on ARCH_IPROC
	select MTD
	select MTD_NAND
	default n
	help
	  This selects a driver for the iProc NAND Controller.
	
	  If unsure, say N.

if IPROC_MTD_NAND

config IPROC_MTD_NAND_USE_JFFS2
	bool "Use JFFS2 on NAND"
    default n
	help
	  Enable this if JFFS2 will be used on NAND. This is to solve compatibility
	  issue for the NAND controller to work with JFFS2 (with some performance
	  degrade).
	  
	  If unsure, say N.

endif # IPROC_MTD_NAND
```

## drivers/staging/bcmdrivers/usb2h/Kconfig
```kconfig
#
# Copyright (C) 2013, Broadcom Corporation. All Rights Reserved.
# 
# Permission to use, copy, modify, and/or distribute this software for any
# purpose with or without fee is hereby granted, provided that the above
# copyright notice and this permission notice appear in all copies.
# 
# THE SOFTWARE IS PROVIDED "AS IS" AND THE AUTHOR DISCLAIMS ALL WARRANTIES
# WITH REGARD TO THIS SOFTWARE INCLUDING ALL IMPLIED WARRANTIES OF
# MERCHANTABILITY AND FITNESS. IN NO EVENT SHALL THE AUTHOR BE LIABLE FOR ANY
# SPECIAL, DIRECT, INDIRECT, OR CONSEQUENTIAL DAMAGES OR ANY DAMAGES
# WHATSOEVER RESULTING FROM LOSS OF USE, DATA OR PROFITS, WHETHER IN AN ACTION
# OF CONTRACT, NEGLIGENCE OR OTHER TORTIOUS ACTION, ARISING OUT OF OR IN
# CONNECTION WITH THE USE OR PERFORMANCE OF THIS SOFTWARE.
#
config IPROC_USB2H
	tristate "USB 2.0 Host support"
	select USB_EHCI_BCM
#	select USB_OHCI_BCM 
## this is for core/message.c:     err = utf16s_to_utf8s
	depends on ARCH_IPROC
	default n
	help
	  Add USB 2.0 Host support
	
	  If unsure, say N.

config USB_EHCI_BCM
        bool "Support for Broadcom on-chip EHCI USB controller"
        depends on USB_EHCI_HCD && ARCH_IPROC && IPROC_USB2H
        ---help---
          Enables EHCI support for USB host controller on some Broadcom
          SOCs.

config USB_OHCI_BCM
        bool "Support for Broadcom on-chip OHCI USB controller"
        depends on USB_OHCI_HCD && ARCH_IPROC && IPROC_USB2H && !MACH_HX4 && !MACH_KT2
        ---help---
          Enables OHCI support for USB host controller on some Broadcom
          SOCs.
```

## drivers/staging/bcmdrivers/usbd/Kconfig
```kconfig
#
# Copyright (C) 2013, Broadcom Corporation. All Rights Reserved.
# 
# Permission to use, copy, modify, and/or distribute this software for any
# purpose with or without fee is hereby granted, provided that the above
# copyright notice and this permission notice appear in all copies.
# 
# THE SOFTWARE IS PROVIDED "AS IS" AND THE AUTHOR DISCLAIMS ALL WARRANTIES
# WITH REGARD TO THIS SOFTWARE INCLUDING ALL IMPLIED WARRANTIES OF
# MERCHANTABILITY AND FITNESS. IN NO EVENT SHALL THE AUTHOR BE LIABLE FOR ANY
# SPECIAL, DIRECT, INDIRECT, OR CONSEQUENTIAL DAMAGES OR ANY DAMAGES
# WHATSOEVER RESULTING FROM LOSS OF USE, DATA OR PROFITS, WHETHER IN AN ACTION
# OF CONTRACT, NEGLIGENCE OR OTHER TORTIOUS ACTION, ARISING OUT OF OR IN
# CONNECTION WITH THE USE OR PERFORMANCE OF THIS SOFTWARE.
#
config IPROC_USB2D
	tristate "USB 2.0 Device"
	select USB_GADGET_DUALSPEED
	depends on ARCH_IPROC && USB_GADGET
	default n
	help
	  Add USB 2.0 Device support
	
	  If unsure, say N.
```

## sound/soc/opv5xc/Kconfig
```kconfig
config SND_SOC_OPV5XC
	tristate "SoC Audio for Open-Silicon OPV5XC SOC"
	depends on ARCH_OPV5XC
	select SND_SOC_GENERIC_DMAENGINE_PCM
	select PL330_DMA
	help
	  Say Y or M here if you want support for SoC audio on OPV5XC.

config SND_SOC_OPV5XC_I2S
	tristate "OPV5XC I2S audio interface"
	depends on (SND_SOC_OPV5XC && !ARCH_OPV5XC_CX4)
	help
	  This enables SoC audio driver for OPV5XC I2S interface.

	  To make I2S audio working, also need to select codec link driver
	  mathing codec chip installed on your board, below.

config SND_SOC_OPV5XC_TLV320AIC23
	tristate "Texas Instruments TLV320AIC23 codec"
	depends on SND_SOC_OPV5XC_I2S
	select SND_SOC_TLV320AIC23
	help
	  This enables support for Texas Instruments TLV320AIC23 codec
	  connected to OPV5XC I2S audio interface.
```
