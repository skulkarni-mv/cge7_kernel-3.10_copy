## drivers/net/ethernet/apm/xgene/Kconfig
```kconfig
config XGENE_NET
	tristate "X-Gene Network Driver"
	depends on ARCH_XGENE
	select XGENE_QMTM
	select PHYLIB
	default n
	help
	  This is the Network driver for X-Gene 1 SOC Ethernet device.

	  To compile this driver as a module, choose M here. This module will
	  be called xgene_enet.

if XGENE_NET
config XGENE_NET_JUMBO_FRAME
	bool "X-Gene 1 SoC Ethernet Jumbo frame support"
	depends on XGENE_NET
	default y
	help
	  Enable this option to have jumbo frame support

config XGENE_NET_IPV4_FORWARD_OFFLOAD
	bool "IPv4 Forward Offload using Inline Classifier"
	depends on (XGENE_NET && XGENE_CLE && !XGENE_NET_JUMBO_FRAME && !XGENE_QMTM_ERROR)
	default n
	help
	  Enable this option to have IPv4 Forward Offload support
endif

config NET_XGENE
       tristate "APM X-Gene Ethernet Driver"
       select PHYLIB
       default y if ARCH_XGENE
       help
         This is the Ethernet driver for the on-chip ethernet interface on the
         APM X-Gene SoC.

         To compile this driver as a module, choose M here. This module will
         be called enet_xgene.

if NET_XGENE
config NET_XGENE_MAC_TO_MAC
	bool "Force SGMII MAC-to-MAC mode"
	default n
	help
	"This option enable mac-to-mac for SGMII-2 2.5Gbps"

config NET_XGENE_DEBUG_UTIL
       bool "APM X-Gene Ethernet Debug Utility"
       depends on NET_XGENE
       default y
       help
         This option enables debug utility for X-Gene Ethernet Driver.

config NET_XGENE_PHY
       bool "APM X-Gene private PHY drivers"
       default n
       help
          This option enables experimental XGene private PHY device driver

endif
```

## drivers/net/ethernet/broadcom/amac/Kconfig
```kconfig
#
# Broadcom AMAC Network configuration
#

config NET_BCM_AMAC
	tristate "Broadcom AMAC Gigabit Ethernet support"
   depends on BROADCOM_PHY && BROADCOM_CMIC_MDIO
	---help---
	  This driver supports the on-chip AMAC Ethernet device

	  To compile this driver as a module, choose M here.

config NET_BCM_AMAC_CUST_VLAN
	bool "Broadcom AMAC driver Custom VLAN support"
	depends on NET_BCM_AMAC
	default n
	---help---
	  This option enables adding a custom VLAN tag in the
	  driver.

	  This option should be removed once the implementation
	  is moved to the application.
```

## drivers/net/ethernet/opensilicon/Kconfig
```kconfig
#
# Open-Silicon network device configuration
#

config NET_VENDOR_OPENSILICON
	bool "Open-Silicon devices"
	default y
	depends on (ARM && ARCH_OPV5XC) && NET

	---help---
	  If you have a network (Ethernet) card belonging to this class, say Y
	  and read the Ethernet-HOWTO, available from
	  <http://www.tldp.org/docs.html#howto>.

	  Note that the answer to this question doesn't directly affect the
	  kernel: saying N will just cause the configurator to skip all
	  the questions about Intel cards. If you say Y, you will be asked for
	  your specific card in the following questions.

if NET_VENDOR_OPENSILICON

config OPV5XC_PSE
	tristate "Open-Silicon Gigabit Ethernet MAC support"
	default m
	depends on NET_VENDOR_OPENSILICON
	select PHYLIB

	---help---
	  This driver supports the gigabit ethernet MACs in the
	  Open-Silicon OPV5XC chipset family.
choice
	prompt "PSE Version"
	depends on OPV5XC_PSE
	default OPV5XC_PSE_ES2 if ARCH_OPV5XC_CX4

config OPV5XC_PSE_ES1
	bool "ES1"
	depends on OPV5XC_PSE && (ARCH_OPV5XC_CX4 || ARCH_OPV5XC_ES1)

config OPV5XC_PSE_ES2
	bool "ES2"
	depends on OPV5XC_PSE && (ARCH_OPV5XC_CX4 || ARCH_OPV5XC_ES2)

endchoice


if OPV5XC_PSE
	config OPV5XC_PSE_NR_MAC_PORTS
	int "Maximum number of MAC ports"
        range 1 2 if OPV5XC_PSE_ES1
        range 1 3 if OPV5XC_PSE_ES2
        default "2"

	config OPV5XC_PSE_ACP_SUPPORT
	bool "ACP control "
	default y
	depends on SMP && (ARCH_OPV5XC_ES1 || ARCH_OPV5XC_ES2)
	---help---
	  Enable ACP control of PSE for DMA HW coherence.

endif # OPV5XC_PSE

endif # NET_VENDOR_OPENSILICON
```

## drivers/pci/host/Kconfig
```kconfig
menu "PCI host controller drivers"
	depends on PCI

config PCI_MVEBU
	bool "Marvell EBU PCIe controller"
	depends on ARCH_MVEBU

config PCI_MVEBU_ARM64
	bool "Marvell EBU PCIe controller for arm64 CPU"
	depends on ARCH_ARMADA_8K
	depends on OF

config DRAM_ON_PCI
	bool "Enable using DRAM on PCI endpoint"
	depends on PCI_MVEBU_ARM64
	help
	 Enables running the system's DRAM on
	 a PCI endpoint. This feature assumes all
	 configuration is done by firmware and simply
	 avoid messing with it.

config IGNORE_ASYNC_ABORT
	bool "Ignore asynchronous abort from configuration access"
	depends on (ARM64 && ARCH_MVEBU)
	help
	 Ignore asynchronous abort caused during configuration
	 access to ports with no endpoint connected.
	 Warning: This will mask all Serror aborts
	 regardless of their cause

config PCI_XILINX_NWL
	bool "NWL PCIe Core"
	depends on ARCH_ZYNQMP && PCI_MSI
	help
	 Say 'Y' here if you want kernel to support for Xilinx
	 NWL PCIe controller.The controller can act as Root Port
	 or End Point.The current option selection will only
	 support root port enabling.

config PCIE_DW
	bool

config PCI_EXYNOS
	bool "Samsung Exynos PCIe controller"
	depends on SOC_EXYNOS5440
	select PCIEPORTBUS
	select PCIE_DW

config PCI_XGENE_MSI
	bool

config PCI_XGENE
	bool "X-Gene PCIe controller"
	depends on ARCH_XGENE
	depends on OF
	select PCI_XGENE_MSI if PCI_MSI
	help
	  Say Y here if you want internal PCI support on APM X-Gene SoC.
	  There are 5 internal PCIe ports available. Each port is GEN3 capable
	  and have varied lanes from x1 to x8.

config PCI_LAYERSCAPE
	bool "Freescale Layerscape PCIe controller"
	depends on OF && (ARM || ARM64)
	select PCIE_DW
	select MFD_SYSCON
	help
	  Say Y here if you want PCIe controller support on Layerscape SoCs.

config PCI_VERSATILE
	bool "ARM Versatile PB PCI controller"
	depends on ARCH_VERSATILE

config PCI_HOST_COMMON
	bool
	select PCI_ECAM

config PCI_HOST_GENERIC
	bool "Generic PCI host controller"
	depends on (ARM || ARM64) && OF
	select PCI_HOST_COMMON
	help
	  Say Y here if you want to support a simple generic PCI host
	  controller, such as the one emulated by kvmtool.


config PCIE_IPROC
	bool "Broadcom iProc PCIe controller"
	select ARCH_SUPPORTS_MSI
	select PCI_DOMAINS if ARCH_NORTHSTAR2
	depends on ARCH_BCM_IPROC || ARCH_NORTHSTAR2

config PCIE_IPROC_MSIX
	bool "MSI-X support on Broadcom iProc PCIe controller"
	depends on PCIE_IPROC
	default n


config PCIE_ARMADA_8K
	bool "Marvell Armada-8K PCIe controller"
	depends on ARCH_MVEBU
	select PCIE_DW
	select PCIEPORTBUS
	help
	  Say Y here if you want to enable PCIe controller support on Armada-8K
	  SoCs. The PCIe controller on Armada-8K is based on Designware hardware
	  and therefore the driver re-uses the Designware core functions to
	  implement the driver.

config PCI_HOST_THUNDER_PEM
	bool "Cavium Thunder PCIe controller to off-chip devices"
	depends on OF && ARM64
	select PCI_HOST_COMMON
	help
	  Say Y here if you want PCIe support for CN88XX Cavium Thunder SoCs.

config PCI_HOST_THUNDER_ECAM
	bool "Cavium Thunder ECAM controller to on-chip devices on pass-1.x silicon"
	depends on OF && ARM64
	select PCI_HOST_COMMON
	help
	  Say Y here if you want ECAM support for CN88XX-Pass-1.x Cavium Thunder SoCs.

endmenu
```

## drivers/phy/Kconfig
```kconfig
#
# PHY
#

menu "PHY Subsystem"

config GENERIC_PHY
	tristate "PHY Core"
	help
	  Generic PHY support.

	  This framework is designed to provide a generic interface for PHY
	  devices present in the kernel. This layer will have the generic
	  API by which phy drivers can create PHY using the phy framework and
	  phy users can obtain reference to the PHY. All the users of this
	  framework should select this config.

config PHY_BCM_NS2_SATA
	bool "Broadcom NorthStar2 SATA phy driver"
	depends on SATA_AHCI_PLATFORM
	depends on ARCH_NORTHSTAR2
	depends on OF
	default y
	select GENERIC_PHY
	help
	  This driver enables support for SATA phy on Broadcom NorthStar2
	  SoC devices.  It is required if you are using the SATA ports.
	  Specific configuration information is read from the device tree.

config BROADCOM_CMIC_MDIO
	bool "Broadcom CMIC MIIM MDIO support"
	depends on ARCH_NORTHSTAR2
	select GENERIC_PHY
    default y
    help
      Support Broadcom CMIC MIIM MDIO controller for internal/external PHY

config PHY_MVEBU_COMPHY
	def_bool y
	depends on ARCH_MVEBU
	depends on OF
	select GENERIC_PHY
	help
	  Enable this to support Marvell comphy driver. This driver is
	  responsible for configuring all SerDes lanes according to the
	  selected configuration.

endmenu
```

## drivers/pinctrl/bcm/Kconfig
```kconfig
if ARCH_NORTHSTAR2

config PINCTRL_NORTHSTAR2_MUX
   bool "Broadcom Northstar2 IOMUX driver"
   depends on ARCH_NORTHSTAR2
   select PINMUX
   select GENERIC_PINCONF
   default ARCH_NORTHSTAR2
   help
     Say yes here to enable the Broadcom Northstar2 IOMUX driver.

     The Broadcom Northstar2 IOMUX driver supports group based IOMUX
     configuration, with the exception that certain individual pins
     can be overrided to GPIO function

config PINCTRL_NORTHSTAR2_GPIO
   bool "Broadcom Northstar2 GPIO (with PINCONF) driver"
   depends on OF_GPIO && ARCH_NORTHSTAR2
   select PINCONF
   select GENERIC_PINCONF
   default ARCH_NORTHSTAR2
   help
     Say yes here to enable the Broadcom Northstar2 GPIO driver.

     The Broadcom Northstar2 SoC has 3 GPIO controllers including the ASIU
     GPIO controller (ASIU), the chipCommonG GPIO controller (CCM), and
     the always-ON GPIO controller (CRMU/AON). All 3 GPIO controllers are
     supported by this driver.

     All 3 Northstar2 GPIO controllers support basic PINCONF functions such
     as bias pull up, pull down, and drive strength settings, when these
     pins are muxed to GPIO.

     Pins from the ASIU GPIO can be individually muxed to GPIO function,
     through the interaction with the Northstar2 IOMUX controller

endif
```

## drivers/power/reset/Kconfig
```kconfig
menuconfig POWER_RESET
	bool "Board level reset or power off"
	help
	  Provides a number of drivers which either reset a complete board
	  or shut it down, by manipulating the main power supply on the board.

	  Say Y here to enable board reset and power off

config POWER_RESET_GPIO
	bool "GPIO power-off driver"
	depends on OF_GPIO && POWER_RESET
	help
	  This driver supports turning off your board via a GPIO line.
	  If your board needs a GPIO high/low to power down, say Y and
	  create a binding in your devicetree.

config POWER_RESET_IPROC
	bool "Broadcom iProc power-off driver"
	depends on ARCH_BCM_IPROC || ARCH_NORTHSTAR2
	depends on POWER_RESET
	help
	  This driver adds support for rebooting iProc SoCs.

config POWER_RESET_QNAP
	bool "QNAP power-off driver"
	depends on OF_GPIO && POWER_RESET && PLAT_ORION
	help
	  This driver supports turning off QNAP NAS devices by sending
	  commands to the microcontroller which controls the main power.

	  Say Y if you have a QNAP NAS.

config POWER_RESET_RESTART
	bool "Restart power-off driver"
	depends on ARM
	help
	  Some boards don't actually have the ability to power off.
	  Instead they restart, and u-boot holds the SoC until the
	  user presses a key. u-boot then boots into Linux.

config POWER_RESET_VEXPRESS
	bool
	depends on POWER_RESET
	help
	  Power off and reset support for the ARM Ltd. Versatile
	  Express boards.

config POWER_RESET_XGENE
	bool "APM SoC X-Gene reset driver"
	depends on ARM64 && ARCH_XGENE
	depends on POWER_RESET
	help
	  Reboot support for the APM SoC X-Gene Eval boards.

config POWER_RESET_LAYERSCAPE
	bool "Freescale LayerScape reset driver"
	depends on ARCH_LAYERSCAPE
	help
	  Reboot support for the Freescale LayerScape SoCs.
```

## drivers/staging/bcmdrivers/Kconfig
```kconfig
#
# Copyright (C) 2013, Broadcom Corporation. All Rights Reserved.
# 
# Permission to use, copy, modify, and/or distribute this software for any
# purpose with or without fee is hereby granted, provided that the above
# copyright notice and this permission notice appear in all copies.
# 
# THE SOFTWARE IS PROVIDED "AS IS" AND THE AUTHOR DISCLAIMS ALL WARRANTIES
# WITH REGARD TO THIS SOFTWARE INCLUDING ALL IMPLIED WARRANTIES OF
# MERCHANTABILITY AND FITNESS. IN NO EVENT SHALL THE AUTHOR BE LIABLE FOR ANY
# SPECIAL, DIRECT, INDIRECT, OR CONSEQUENTIAL DAMAGES OR ANY DAMAGES
# WHATSOEVER RESULTING FROM LOSS OF USE, DATA OR PROFITS, WHETHER IN AN ACTION
# OF CONTRACT, NEGLIGENCE OR OTHER TORTIOUS ACTION, ARISING OUT OF OR IN
# CONNECTION WITH THE USE OR PERFORMANCE OF THIS SOFTWARE.
#
menu "Broadcom iProc Drivers"
	depends on ARCH_IPROC


source "drivers/staging/bcmdrivers/timer/Kconfig"
source "drivers/staging/bcmdrivers/otp/Kconfig"
source "drivers/staging/bcmdrivers/rng/Kconfig"
source "drivers/staging/bcmdrivers/mdio/Kconfig"
source "drivers/staging/bcmdrivers/gsio_spi/Kconfig"
source "drivers/staging/bcmdrivers/sd/Kconfig"
source "drivers/staging/bcmdrivers/gpio/Kconfig"
source "drivers/staging/bcmdrivers/qspi/Kconfig"
source "drivers/staging/bcmdrivers/nand/Kconfig"
source "drivers/staging/bcmdrivers/usb2h/Kconfig"
source "drivers/staging/bcmdrivers/usb3h/Kconfig"
source "drivers/staging/bcmdrivers/usbd/Kconfig"
source "drivers/staging/bcmdrivers/pcie/Kconfig"
source "drivers/staging/bcmdrivers/gmac/et/Kconfig"
source "drivers/staging/bcmdrivers/gmac/hnd/Kconfig"
#source "../../bcmdrivers/smbus/Kconfig"
source "drivers/staging/bcmdrivers/sra/Kconfig"
source "drivers/staging/bcmdrivers/pmu/Kconfig"
source "drivers/staging/bcmdrivers/dte/Kconfig"


config BCM_IPROC_CA9_PREFETCH
	tristate "CortexA9 cache auto-prefetching support"
	depends on ARCH_IPROC
	default n
	help
	  Enable iProc CortexA9 L1/L2 cache auto-prefetching support
	
	  If unsure, say N.

config BCM_BARRIER_PERFORMANCE
	bool "Linux memory barrier performance improvement"
	depends on ARCH_IPROC
	default n
	help
	  Enable linux memory barrier performance improvements
	
	  If unsure, say N.

config BCM_MEM_OPTIMIZATION
	bool "ARM Memory library optimization"
	depends on ARCH_IPROC
	default n
	help
	  Enable ARM memory library optimization
	
	  If unsure, say N.

config BROADCOM_CUSTOM_SENDFILE
	bool "Custom Sendfile optimization"
	depends on ARCH_IPROC
	default n
	help
	  Enable Broadcom Custom Sendfile optimization
	
	  If unsure, say N.

config BCM_CUSTOM_RECVFILE
	bool "Custom Receivefile optimization"
	depends on ARCH_IPROC
	default n
	help
	  Enable Broadcom Custom Receivefile optimization
	
	  If unsure, say N.

config BCM_CUSTOM_RECVFILE_MAX_PERF
# Enabling BCM_CUSTOM_RECVFILE_MAX_PERF gives maximum write performance 
# at the risk of filesystem errors (due to skipping cache invalidation 
# on writes) and exposure to A0 hardware errata for lazy interrupts.
	bool "Custom Receivefile Max Performance optimization"
	depends on ARCH_IPROC && BCM_CUSTOM_RECVFILE
	default n
	help
	  Enable Broadcom Custom Receivefile Maximum Performance optimization
	
	  If unsure, say N.

config BCM_GRO_ENABLE
	bool "Broadcom GRO Enable"
	depends on ARCH_IPROC && (ET_NAPI_POLL || ET_NAPI2_POLL)
	default n
	help
	  Enable Broadcom Generic Receive Offload
	
	  If unsure, say N.


### kdrivers
##  kdrivers/nor integrated at ../kernel/linux-3.6.5/drivers/mtd/Makefile
##  CFI driver required to be integrated before the bsp file builds

### hook for gpl driver master file
source "drivers/staging/bcmgpldrivers/Kconfig"
### hook for partner driver master file
#source "../../bcmpartnerdrivers/Kconfig"
endmenu
```
