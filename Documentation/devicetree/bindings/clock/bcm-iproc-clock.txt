## arch/arm64/configs/northstar2_defconfig
```kconfig
# CONFIG_LOCALVERSION_AUTO is not set
# CONFIG_SWAP is not set
CONFIG_SYSVIPC=y
CONFIG_IKCONFIG=y
CONFIG_IKCONFIG_PROC=y
# CONFIG_UTS_NS is not set
# CONFIG_PID_NS is not set
CONFIG_BLK_DEV_INITRD=y
CONFIG_PERF_EVENTS=y
CONFIG_MODULES=y
CONFIG_MODULE_UNLOAD=y
# CONFIG_IOSCHED_DEADLINE is not set
# CONFIG_IOSCHED_CFQ is not set
CONFIG_ARCH_NORTHSTAR2=y
CONFIG_PCI=y
CONFIG_PCI_MSI=y
CONFIG_PCIE_IPROC=y
CONFIG_SMP=y
# CONFIG_SPARSEMEM_VMEMMAP is not set
# CONFIG_COMPACTION is not set
# CONFIG_BOUNCE is not set
# CONFIG_CROSS_MEMORY_ATTACH is not set
CONFIG_BINFMT_MISC=y
CONFIG_NET=y
CONFIG_PACKET=y
CONFIG_UNIX=y
CONFIG_INET=y
CONFIG_IP_PNP=y
CONFIG_IP_PNP_DHCP=y
CONFIG_IP_PNP_BOOTP=y
# CONFIG_IPV6 is not set
CONFIG_NETFILTER=y
CONFIG_DEVTMPFS=y
CONFIG_DEVTMPFS_MOUNT=y
# CONFIG_STANDALONE is not set
# CONFIG_PREVENT_FIRMWARE_BUILD is not set
# CONFIG_FIRMWARE_IN_KERNEL is not set
# CONFIG_FW_LOADER_USER_HELPER is not set
CONFIG_MTD_CMDLINE_PARTS=y
CONFIG_MTD_NAND=y
CONFIG_MTD_NAND_IPROC=y
CONFIG_MTD_SPI_NOR=y
CONFIG_MTD_SPI_NOR_TMP_4BYTE=y
CONFIG_MTD_UBI=y
CONFIG_MTD_UBI_BEB_LIMIT=2
# CONFIG_BLK_DEV is not set
CONFIG_BLK_DEV_SD=y
CONFIG_CHR_DEV_SG=y
CONFIG_SCSI_CONSTANTS=y
CONFIG_SCSI_LOGGING=y
CONFIG_ATA=y
CONFIG_SATA_AHCI=y
CONFIG_SATA_AHCI_PLATFORM=y
# CONFIG_ATA_SFF is not set
CONFIG_NETDEVICES=y
CONFIG_NET_BCM_AMAC=y
CONFIG_PHYLIB=y
CONFIG_BROADCOM_PHY=y
# CONFIG_INPUT_MOUSEDEV is not set
# CONFIG_INPUT_KEYBOARD is not set
# CONFIG_INPUT_MOUSE is not set
# CONFIG_SERIO is not set
# CONFIG_LEGACY_PTYS is not set
# CONFIG_DEVKMEM is not set
CONFIG_SERIAL_8250=y
CONFIG_SERIAL_8250_CONSOLE=y
CONFIG_SERIAL_8250_DW=y
CONFIG_HW_RANDOM=y
CONFIG_I2C=y
CONFIG_I2C_CHARDEV=y
CONFIG_I2C_BCM_IPROC=y
CONFIG_SPI=y
CONFIG_IPROC_QSPI=y
CONFIG_GPIOLIB=y
CONFIG_GPIO_SYSFS=y
CONFIG_POWER_RESET_IPROC=y
# CONFIG_HWMON is not set
CONFIG_WATCHDOG=y
CONFIG_ARM_SP805_WATCHDOG=y
CONFIG_BCM_IPROC_BBL=y
CONFIG_MFD_SYSCON=y
CONFIG_USB=y
CONFIG_USB_ANNOUNCE_NEW_DEVICES=y
CONFIG_USB_EHCI_HCD=y
CONFIG_USB_EHCI_ROOT_HUB_TT=y
CONFIG_USB_EHCI_HCD_PLATFORM=y
CONFIG_USB_STORAGE=y
CONFIG_USB_PHY=y
CONFIG_BCM_NS2_USB2_PHY=y
CONFIG_NEW_LEDS=y
CONFIG_LEDS_CLASS=y
CONFIG_LEDS_BRCM_XGXS=y
CONFIG_RTC_CLASS=y
CONFIG_DMADEVICES=y
CONFIG_PL330_DMA=y
CONFIG_ARM_TIMER_SP804=y
CONFIG_ARM_SP804_AS_PRIVATE_TIMER=y
# CONFIG_IOMMU_SUPPORT is not set
CONFIG_PWM=y
CONFIG_PWM_IPROC=y
CONFIG_EXT2_FS=y
CONFIG_EXT2_FS_XATTR=y
CONFIG_EXT3_FS=y
CONFIG_EXT4_FS=y
# CONFIG_DNOTIFY is not set
# CONFIG_INOTIFY_USER is not set
CONFIG_MSDOS_FS=y
CONFIG_VFAT_FS=y
CONFIG_TMPFS=y
CONFIG_UBIFS_FS=y
CONFIG_NFS_FS=y
CONFIG_NFS_V3_ACL=y
CONFIG_NFS_V4=y
CONFIG_NFS_V4_1=y
CONFIG_ROOT_NFS=y
CONFIG_NLS_CODEPAGE_437=y
CONFIG_NLS_ISO8859_1=y
# CONFIG_ENABLE_WARN_DEPRECATED is not set
# CONFIG_ENABLE_MUST_CHECK is not set
CONFIG_DEBUG_FS=y
# CONFIG_FRAME_POINTER is not set
# CONFIG_CRYPTO_ANSI_CPRNG is not set
# CONFIG_CRYPTO_HW is not set
```

## arch/powerpc/sysdev/apmqm/Kconfig
```kconfig
# For a description of the syntax of this configuration file,
# see Documentation/kbuild/kconfig-language.txt.
#

config APMQM
        tristate "APM 86xxx QM driver"
	depends on APM86xxx
        default n
        help
          This option enables APM86xxx Queue Manager (QM) driver support
          requires for APM86xxx DMA, Ethernet, and security hardware.

if APMQM
config APMQM_CFG
        tristate "APM 86xxx QM Configuration Driver"
	depends on APMQM
        default n
        help
          This option enables APM86xxx Queue Manager (QM) configuration
	  driver.
endif
```

## drivers/bus/Kconfig
```kconfig
#
# Bus Devices
#

menu "Bus devices"

config MVEBU_MBUS
	bool
	depends on PLAT_ORION
	help
	  Driver needed for the MBus configuration on Marvell EBU SoCs
	  (Kirkwood, Dove, Orion5x, MV78XX0 and Armada 370/XP).

config OMAP_OCP2SCP
	tristate "OMAP OCP2SCP DRIVER"
	depends on ARCH_OMAP2PLUS
	help
	  Driver to enable ocp2scp module which transforms ocp interface
	  protocol to scp protocol. In OMAP4, USB PHY is connected via
	  OCP2SCP and in OMAP5, both USB PHY and SATA PHY is connected via
	  OCP2SCP.

config OMAP_INTERCONNECT
	tristate "OMAP INTERCONNECT DRIVER"
	depends on ARCH_OMAP2PLUS

	help
	  Driver to enable OMAP interconnect error handling driver.

config ARM_CCI
	bool "ARM CCI driver support"
	depends on ARM
	help
	  Driver supporting the CCI cache coherent interconnect for ARM
	  platforms.

config XGENE_AHBC
        tristate "X-Gene SoC AHB Bus Driver"
        depends on ARM64 && ARCH_XGENE
        default y if ARCH_XGENE
        help
          X-Gene SoC AHB bus driver is required for SPI and
          SDIO to function properly.

config XGENE_PCP
        tristate "X-Gene SoC PCP Bus Driver"
        depends on ARM64 && ARCH_XGENE
        default y if ARCH_XGENE
        help
          X-Gene SoC PCP bus driver is required for error reporting.

config XGENE_PMU
        tristate "X-Gene SoC PMU Driver"
        depends on ARM64 && ARCH_XGENE
        default y if ARCH_XGENE
        help
          X-Gene SoC PMU driver.

endmenu
```

## drivers/clk/gpt/Kconfig
```kconfig
#
# GPT driver configuration
#
menuconfig GENERAL_PURPOSE_TIMER
	bool "General Purpose Timer Support"
	depends on COMMON_CLK_XGENE
	default y

if GENERAL_PURPOSE_TIMER

comment "General Purpose Timer"

config XGENE_GPT
	tristate "APM X-Gene GPT"
	default y
	help
	  If you say yes here you get support for the APM X-Gene General Purpose Driver.

	  This driver can also be built as a module, if so, the module
	  will be called "xgene-gpt".
endif
```

## drivers/clk/mvebu/Kconfig
```kconfig
config MVEBU_CLK_CORE
       bool

config MVEBU_CLK_CPU
       bool

config MVEBU_CLK_GATING
       bool

config MVEBU_CLK_COREDIV
	bool

config MVEBU_CLK_COMMON
	bool

config ARMADA_3700_CLK
       bool
       select MVEBU_CLK_COMMON

config ARMADA_AP806_CLK
       select ARMADA_8K_CLK_COMMON
       bool

config ARMADA_8K_CLK_COMMON
       bool

config ARMADA_AP806_SYSCON
	bool

config ARMADA_AP806_CORE_CLK
       bool

config ARMADA_AP806_RING_CLK
       bool

config ARMADA_AP806_CPU_CLK
       bool

config ARMADA_CP110_SYSCON
       bool
```

## drivers/clocksource/Kconfig
```kconfig
config CLKSRC_OF
	bool

config CLKSRC_I8253
	bool

config CLKEVT_I8253
	bool

config I8253_LOCK
	bool

config CLKBLD_I8253
	def_bool y if CLKSRC_I8253 || CLKEVT_I8253 || I8253_LOCK

config CLKSRC_MMIO
	bool

config DW_APB_TIMER
	bool

config DW_APB_TIMER_OF
	bool

config ARMADA_370_XP_TIMER
	bool
	select CLKSRC_OF

config SUN4I_TIMER
	bool

config VT8500_TIMER
	bool

config CADENCE_TTC_TIMER
	bool

config CLKSRC_NOMADIK_MTU
	bool
	depends on (ARCH_NOMADIK || ARCH_U8500)
	select CLKSRC_MMIO
	help
	  Support for Multi Timer Unit. MTU provides access
	  to multiple interrupt generating programmable
	  32-bit free running decrementing counters.

config CLKSRC_NOMADIK_MTU_SCHED_CLOCK
	bool
	depends on CLKSRC_NOMADIK_MTU
	help
	  Use the Multi Timer Unit as the sched_clock.

config CLKSRC_DBX500_PRCMU
	bool "Clocksource PRCMU Timer"
	depends on UX500_SOC_DB8500
	default y
	help
	  Use the always on PRCMU Timer as clocksource

config CLKSRC_DBX500_PRCMU_SCHED_CLOCK
	bool "Clocksource PRCMU Timer sched_clock"
	depends on (CLKSRC_DBX500_PRCMU && !CLKSRC_NOMADIK_MTU_SCHED_CLOCK)
	default y
	help
	  Use the always on PRCMU Timer as sched_clock

config ARM_ARCH_TIMER
	bool
	select CLKSRC_OF if OF

config ARM_TIMER_SP804
	bool "Support for Dual Timer SP804 module"
	depends on GENERIC_SCHED_CLOCK
	select CLKSRC_MMIO
	select CLKSRC_OF if OF

config ARM_SP804_AS_PRIVATE_TIMER
	bool "Enable ARM dual timer SP804 as private timer"
	depends on ARM_TIMER_SP804
	default n
	help
	 Use ARM dual timer sp804 as private timer.
	 For multiple instances of SP804, only one can be used as standard clock
	 source and remaining instances are silently ignored.
	 This config extends SP804 module support as private timers.
	 Each instance provides two timers and user level application can use
	 posix based timer APIs to create separate timers as per requirement.

config CLKSRC_METAG_GENERIC
	def_bool y if METAG
	help
	  This option enables support for the Meta per-thread timers.

config CLKSRC_EXYNOS_MCT
	def_bool y if ARCH_EXYNOS
	help
	  Support for Multi Core Timer controller on Exynos SoCs.

config CLKSRC_SAMSUNG_PWM
	bool
	select CLKSRC_MMIO
	help
	  This is a new clocksource driver for the PWM timer found in
	  Samsung S3C, S5P and Exynos SoCs, replacing an earlier driver
	  for all devicetree enabled platforms. This driver will be
	  needed only on systems that do not have the Exynos MCT available.
```

## drivers/mailbox/Kconfig
```kconfig
menuconfig MAILBOX
	bool "Mailbox Hardware Support"
	help
	  Mailbox is a framework to control hardware communication between
	  on-chip processors through queued messages and interrupt driven
	  signals. Say Y if your platform supports hardware mailboxes.

if MAILBOX
config PL320_MBOX
	bool "ARM PL320 Mailbox"
	depends on ARM_AMBA
	help
	  An implementation of the ARM PL320 Interprocessor Communication
	  Mailbox (IPCM), tailored for the Calxeda Highbank. It is used to
	  send short messages between Highbank's A9 cores and the EnergyCore
	  Management Engine, primarily for cpufreq. Say Y here if you want
	  to use the PL320 IPCM support.

config XGENE_SLIMPRO_MBOX
	tristate "APM SoC X-Gene SlimPRO Mailbox Controller"
	help
	  An implementation of the APM X-Gene Interprocessor Communication
	  Mailbox (IPCM) between the ARM 64-bit cores and SlimPRO controller.
	  It is used to send short messages between ARM64-bit cores and
	  the SlimPRO Management Engine, primarily for PM. Say Y here if you
	  want to use the APM X-Gene SlimPRO IPCM support.

endif
```

## drivers/misc/xgene/cle/Kconfig
```kconfig
config XGENE_CLE
	tristate "X-Gene Clasifier Engine"
	depends on ARCH_XGENE
	default n
	help
	  This option enables dirver for Inline (for Ethernet) and
	  LookAside Clasifier Engine for X-Gene SoC.
```

## drivers/misc/xgene/slimpro/Kconfig
```kconfig
config XGENE_SLIMPRO_PM
        bool "APM SoC X-Gene SlimPRO Power Management driver"
        depends on XGENE_SLIMPRO_MBOX
	default n
        help
          Provides interface to various Power Management parameters
	  as implemented by X-Gene SlimPro co-processor
```

## drivers/mtd/spi-nor/Kconfig
```kconfig
menuconfig MTD_SPI_NOR
	tristate "SPI-NOR device support"
	depends on MTD
	help
	  This is the framework for the SPI NOR which can be used by the SPI
	  device drivers and the SPI-NOR device driver.

if MTD_SPI_NOR

config MTD_SPI_NOR_USE_4K_SECTORS
	bool "Use small 4096 B erase sectors"
	default y
	help
	  Many flash memories support erasing small (4096 B) sectors. Depending
	  on the usage this feature may provide performance gain in comparison
	  to erasing whole blocks (32/64 KiB).
	  Changing a small part of the flash's contents is usually faster with
	  small sectors. On the other hand erasing should be faster when using
	  64 KiB block instead of 16 × 4 KiB sectors.

	  Please note that some tools/drivers/filesystems may not work with
	  4096 B erase size (e.g. UBIFS requires 15 KiB as a minimum).

config MTD_SPI_NOR_TMP_4BYTE
	bool "Avoid keeping device in 4-byte address mode"
	default n
	help
	  For flash memories larger than 16 Mib, 4 bytes are needed for
	  addressing. For compatibility, these chips by default still use
	  3-byte addresses, which limits accessible space to 16 Mib.
	  To access the rest, chip has to be explicitly switched to 4-byte
	  address mode, that changes standard read/write/erase opcodes to
	  expect 4-byte addresses. Alternatively, some chips provide dedicated
	  opcodes that use 4-byte addresses without standard opcodes behavior.

	  4-byte address mode can be problematic for boards that boot from
	  SPI flash: in case of software reboot, chip remains in 4-byte address
	  mode, while boot hardware and/or firmware expects 3-byte address mode.
	  This commonly results into boot hang.

	  Some chips (i.e. Micron n25q512a) do provide dedicated 4-byte read
	  opcodes, but not dedicated 4-byte write/erase opcodes. By default,
	  driver does switch such a chip to 4-byte address mode.

	  With this option enabled, driver keeps such a chip in default
	  3-byte address mode, and temporary switches it to 4-byte address
	  mode for duration of write/erase operaions. This workarounds reboot
	  issue at cost of slight write/erase performance decrease.

	  If soft-reboot happens in the middle of write/erase operation, chip
	  is left in 4-byte address mode and thus reboot can fail. For
	  reliable operation, need to provide a workaround in hardware or
	  firmware, or simply not use booting from affected chip.

	  If you don't understand what's all that about, just say N.

config SPI_FSL_QUADSPI
	tristate "Freescale Quad SPI controller"
	depends on ARCH_MXC || SOC_LS1021A || ARCH_LAYERSCAPE
	help
	  This enables support for the Quad SPI controller in master mode.
	  We only connect the NOR to this controller now.

endif # MTD_SPI_NOR
```

## drivers/net/apm/Kconfig
```kconfig
# For a description of the syntax of this configuration file,
# see Documentation/kbuild/kconfig-language.txt.
#
config APM_CLE
	bool "APM86xxx Clasifier Engine API"
	depends on APM86xxx
	default n
	---help---
	  This is the Inline (for Ethernet) and LookAside Clasifier Engine API
	  for APM86xxx SoC.

config APM_NET
	tristate "APM86xxx Network Driver"
	depends on APM86xxx
	select APM_CLE
	select APMQM
	default n
	---help---
	  This is the Network driver for APM86xxx Ethernet device.

	  To compile this driver as a module, choose M here. This module will
	  be called apm_enet.

config APM_NET_SKB_HEADROOM
	int "Additional skb headroom (bytes)"
	depends on APM_NET
	default "0"
	help
	  Additional receive skb headroom. Change this if requires a bigger
	  SKB Headroom than the default for optimized performance (ie IPSEC in
	  offline security). Note, the driver will always reserve at least
	  2 bytes to make IP header aligned.

	  If unsure, set to 0.

config APM_VNET
	tristate "APM86xxx Virtual Network Driver for ICC"
	select APM_NET
	select DMADEVICES
	select APM_PKTDMA
	depends on APM86xxx
	default n
	help
	  This is the virtual network driver for Inter Core Communication.

	  To compile this driver as a module, choose M here. This module will
	  be called apm_vnet.
```
