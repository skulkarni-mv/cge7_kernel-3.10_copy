## arch/arm64/Kconfig
```kconfig
config ARM64
	def_bool y
	select ARCH_HAS_ATOMIC64_DEC_IF_POSITIVE
	select ARCH_HAS_ELF_RANDOMIZE
	select ARCH_USE_CMPXCHG_LOCKREF
	select ARCH_SUPPORTS_ATOMIC_RMW
	select ARCH_WANT_OPTIONAL_GPIOLIB
	select ARCH_WANT_COMPAT_IPC_PARSE_VERSION
	select ARCH_WANT_FRAME_POINTERS
	select ARM_AMBA
	select ARM_ARCH_TIMER
	select ARM_GIC
	select ARM_GIC_V3
	select ARM_GIC_V3_ITS
	select BUILDTIME_EXTABLE_SORT
	select CLONE_BACKWARDS
	select COMMON_CLK
	select EDAC_SUPPORT
	select DCACHE_WORD_ACCESS
	select GENERIC_CLOCKEVENTS
	select GENERIC_CPU_AUTOPROBE
	select GENERIC_IOMAP
	select GENERIC_IRQ_PROBE
	select GENERIC_IRQ_SHOW
	select GENERIC_SCHED_CLOCK
	select GENERIC_SMP_IDLE_THREAD
	select GENERIC_STRNCPY_FROM_USER
	select GENERIC_STRNLEN_USER
	select GENERIC_TIME_VSYSCALL
	select HANDLE_DOMAIN_IRQ
	select HARDIRQS_SW_RESEND
	select IRQ_FORCED_THREADING
	select HAVE_ARCH_KGDB
	select HAVE_ARCH_TRACEHOOK
	select HAVE_C_RECORDMCOUNT
	select HAVE_DEBUG_BUGVERBOSE
	select HAVE_DEBUG_KMEMLEAK
	select HAVE_DMA_API_DEBUG
	select HAVE_DMA_ATTRS
	select HAVE_DMA_CONTIGUOUS if !ARCH_THUNDER
	select HAVE_DYNAMIC_FTRACE
	select HAVE_FTRACE_MCOUNT_RECORD
	select HAVE_FUNCTION_GRAPH_TRACER
	select HAVE_FUNCTION_TRACER
	select HAVE_GENERIC_DMA_COHERENT
	select HAVE_GENERIC_HARDIRQS
	select HAVE_HW_BREAKPOINT if PERF_EVENTS
	select HAVE_MEMBLOCK
	select HAVE_PERF_EVENTS
	select HAVE_PREEMPT_LAZY
	select IRQ_DOMAIN
	select MODULES_USE_ELF_RELA
	select NO_BOOTMEM
	select OF
	select OF_EARLY_FLATTREE
	select OF_RESERVED_MEM
	select PERF_USE_VMALLOC
	select POWER_RESET
	select POWER_SUPPLY
	select RTC_LIB
	select SPARSE_IRQ
	select SYSCTL_EXCEPTION_TRACE
	help
	  ARM 64-bit (AArch64) Linux support.

config 64BIT
	def_bool y

config ARCH_PHYS_ADDR_T_64BIT
	def_bool y

config MMU
	def_bool y

config NO_IOPORT
	def_bool y if !PCI

config STACKTRACE_SUPPORT
	def_bool y

config ILLEGAL_POINTER_VALUE
	hex
	default 0xdead000000000000

config LOCKDEP_SUPPORT
	def_bool y

config TRACE_IRQFLAGS_SUPPORT
	def_bool y

config GENERIC_LOCKBREAK
	def_bool y
	depends on SMP && PREEMPT

config RWSEM_GENERIC_SPINLOCK
	def_bool y

config GENERIC_HWEIGHT
	def_bool y

config GENERIC_CSUM
        def_bool y

config GENERIC_CALIBRATE_DELAY
	def_bool y

config ZONE_DMA
	def_bool y

config ARCH_DMA_ADDR_T_64BIT
	def_bool y

config NEED_DMA_MAP_STATE
	def_bool y

config NEED_SG_DMA_LENGTH
	def_bool y

config SWIOTLB
	def_bool y

config IOMMU_HELPER
	def_bool SWIOTLB

config ARCH_SUPPORTS_48BIT_PA
	def_bool n

config KERNEL_MODE_NEON
	def_bool y

source "init/Kconfig"

source "kernel/Kconfig.freezer"

menu "Platform selection"

config ARCH_MVEBU
	bool "Marvell EBU SoC Family"
	select ARM_GIC_ODMI
	select MVEBU_PIC
	select MVEBU_SEI_IRQ
	select MVEBU_CLK_COMMON
	select ARMADA_3700_CLK
	select ARMADA_AP806_CORE_CLK
	select ARMADA_AP806_RING_CLK
	select ARMADA_AP806_CPU_CLK
	select ARMADA_AP806_SYSCON
	select ARMADA_CP110_SYSCON
	select ARM_GIC_V2M if PCI_MSI
	help
	  This enables support for Marvell EBU familly, including:
	   - Armada 3700 SoC Family
	   - Armada 7K SoC Family
	   - Armada 8K SoC Family

config ARCH_VEXPRESS
	bool "ARMv8 software model (Versatile Express)"
	select ARCH_REQUIRE_GPIOLIB
	select COMMON_CLK_VERSATILE
	select POWER_RESET_VEXPRESS
	select VEXPRESS_CONFIG
	help
	  This enables support for the ARMv8 software model (Versatile
	  Express).

config ARCH_FSL_LS1043A
	bool "Freescale LS1043A SOC"
	select LS1_MSI if PCI_MSI
	help
	  This enables support for Freescale LS1043A SOC.

config LS2085A_ERRATA_ERR008585
	bool "Freescale LS2085A SOC Errata ERR008585"
	help
	  This enables support for Freescale LS2085A SOC Errata ERR008585, which
	  is related to ARM generic timers. The Errata is related to spurious
	  arriving from ARM generic timers. Software should read registers
	  CNTHP_TVAL, CNTP_TVAL, CNTPS_TVAL, CNTV_TVAL, CNTPCT, or CNTVCT twice.
	  If the value read differs, then re-read the register, and continue to
	  read until two consecutive reads return the same value.

config LS2085A_ERRATA_TKT269926
	bool "Freescale LS2085A SOC issue TKT269926"
	help
	  This enables support for workaround for Freescale LS2085A SOC
	  open issue TKT269926. This issue is related to CNTP_TVAL register
	  not getting properly set leading to delay in timer interrupt
	  being generated. As a workaround software clears the CNTP_TVAL
	  register and then write again in case it finds mismatch between

config ARCH_LAYERSCAPE
	bool "Freescale Layerscape SoC family"
	select LS2085A_ERRATA_ERR008585
	select LS2085A_ERRATA_TKT269926
	help
	  This enables support for Freescale Layerscape SoC family

config ARCH_THUNDER
	bool "Cavium Inc. Thunder SoC Family"
	select PCI
	select PCI_HOST_GENERIC
	select ARCH_SUPPORTS_48BIT_PA
	select ARCH_REQUIRE_GPIOLIB
	select COMMON_CLK_VERSATILE
	select SATA_AHCI
	select SATA_AHCI_PLATFORM
	select ATA
	select NET_VENDOR_CAVIUM
	select PHYLIB
	select MARVELL_PHY
	select BROADCOM_PHY
	select BCM87XX_PHY
	select IOMMU_SUPPORT
	help
	  This enables support for Cavium's Thunder Family of SoCs.

config ARCH_XGENE
        bool "AppliedMicro X-Gene SOC Family"
	select NO_GENERIC_PCI_IOPORT_MAP
	select MFD_SYSCON
	select PCI
	select PCI_DOMAINS
        help
          This enables support for AppliedMicro X-Gene SOC Family

config ARCH_ZYNQMP
       bool "Xilinx ZynqMP Family"
       help
         This enables support for Xilinx ZynqMP Family

config ARCH_ARMADA_8K
	bool "Armada-8K SOC family"
	select ARMADA_AP806_CLK
	help
	  This enables support for Armada-8k SOC Family

comment "Processor Features"

config V7_OBSOLETE
	bool "Emulate obsolete ARMv7 instructions"
	depends on COMPAT
	help
	  AArch32 legacy software support may require certain
	  instructions that have been deprecated or obsoleted in the
	  architecture.

	  Enable this config to enable selective emulation of these
	  features.

	  If unsure, say N

if V7_OBSOLETE

config SWP_EMULATION
	bool "Emulate SWP/SWPB instructions"
	help
	  ARMv8 obsoletes the use of SWP/SWPB instructions such that
	  they are always undefined. Say Y here to enable software
	  emulation of these instructions for userspace (not kernel)
	  using LDXR/STXR.

	  In some older versions of glibc [<=2.8] SWP is used during futex
	  trylock() operations with the assumption that the code will not
	  be preempted. This invalid assumption may be more likely to fail
	  with SWP emulation enabled, leading to deadlock of the user
	  application.

	  NOTE: when accessing uncached shared regions, LDXR/STXR rely
	  on an external transaction monitoring block called a global
	  monitor to maintain update atomicity. If your system does not
	  implement a global monitor, this option can cause programs that
	  perform SWP operations to uncached memory to deadlock.

	  If unsure, say N

config CP15_BARRIER_EMULATION
	bool "Emulate CP15 Barrier instructions"
	help
	  ARMv7 architecture deprecates the use of CP15 barrier
	  instructions - CP15ISB, CP15DSB and CP15DMB. It is strongly
	  recommended to use the ISB, DSB and DMB instructions
	  instead.

	  Say Y here to enable software emulation of these
	  instructions for AArch32 userspace code. When emulation
	  is enabled, statistics related to the occurrence of these
	  instructions are also made available via debugfs.

	  If unsure, say N

endif

menu   "Cavium ThunderX errata"

config THUNDERX_PASS1_ERRATA_22558
        bool "Cavium ThunderX erratum 22558"
        depends on ARCH_THUNDER
        def_bool ARCH_THUNDER
        help
                Enable workaround for erratum 22558.

config THUNDERX_PASS1_ERRATA_23154
        bool "Cavium ThunderX erratum 23154"
        depends on ARCH_THUNDER
        def_bool ARCH_THUNDER
        help
                Enable workaround for erratum 23154.

config THUNDERX_PASS1_ERRATA_23144
        bool "Cavium ThunderX erratum 23144"
        depends on ARCH_THUNDER && NUMA
        def_bool ARCH_THUNDER
        help
                Enable workaround for erratum 23144.

config THUNDERX_PASS1_ERRATA_26026
        bool "Cavium ThunderX erratum 26026"
        depends on ARCH_THUNDER
        def_bool ARCH_THUNDER
        select OPTIMIZE_MANY_CPUS
        help
                Enable workaround for erratum 26026.


endmenu

config ARCH_NORTHSTAR2
	select ARM_GIC
	select PINCTRL
	select COMMON_CLK_IPROC
	bool "Broadcom NorthStar2 SOC Family"
	help
	  This enables support for the Broadcom NorthStar2 SOC Family

endmenu

menu "Bus support"

config ARM_AMBA
	bool

config HAS_FSL_QBMAN_V03
	bool "Datapath Acceleration Queue and Buffer management on FSL-LS1043A"
	help
	  Datapath Acceleration Queue and Buffer management on FSL-LS1043A

config PCI
	bool "PCI support"
	help
	  This feature enables support for PCIe bus system. If you say Y
	  here, the kernel will include drivers and infrastructure code
	  to support PCIe bus devices.

config PCI_DOMAINS
	def_bool PCI

config PCI_DOMAINS_GENERIC
	def_bool PCI

config PCI_SYSCALL
	def_bool PCI

config PCI_MMCONFIG
	def_bool PCI && ACPI

source "drivers/pci/Kconfig"
source "drivers/pci/pcie/Kconfig"
source "drivers/pci/hotplug/Kconfig"

endmenu

menu "Kernel Features"


menu "ARM errata workarounds via the alternatives framework"

config ARM64_ERRATUM_826319
	bool "Cortex-A53: 826319: System might deadlock if a write cannot complete until read data is accepted"
	default y
	help
	  This option adds an alternative code sequence to work around ARM
	  erratum 826319 on Cortex-A53 parts up to r0p2 with an AMBA 4 ACE or
	  AXI master interface and an L2 cache.

	  If a Cortex-A53 uses an AMBA AXI4 ACE interface to other processors
	  and is unable to accept a certain write via this interface, it will
	  not progress on read data presented on the read data channel and the
	  system can deadlock.

	  The workaround promotes data cache clean instructions to
	  data cache clean-and-invalidate.
	  Please note that this does not necessarily enable the workaround,
	  as it depends on the alternative framework, which will only patch
	  the kernel if an affected CPU is detected.

	  If unsure, say Y.

config ARM64_ERRATUM_827319
	bool "Cortex-A53: 827319: Data cache clean instructions might cause overlapping transactions to the interconnect"
	default y
	help
	  This option adds an alternative code sequence to work around ARM
	  erratum 827319 on Cortex-A53 parts up to r0p2 with an AMBA 5 CHI
	  master interface and an L2 cache.

	  Under certain conditions this erratum can cause a clean line eviction
	  to occur at the same time as another transaction to the same address
	  on the AMBA 5 CHI interface, which can cause data corruption if the
	  interconnect reorders the two transactions.

	  The workaround promotes data cache clean instructions to
	  data cache clean-and-invalidate.
	  Please note that this does not necessarily enable the workaround,
	  as it depends on the alternative framework, which will only patch
	  the kernel if an affected CPU is detected.

	  If unsure, say Y.

config ARM64_ERRATUM_824069
	bool "Cortex-A53: 824069: Cache line might not be marked as clean after a CleanShared snoop"
	default y
	help
	  This option adds an alternative code sequence to work around ARM
	  erratum 824069 on Cortex-A53 parts up to r0p2 when it is connected
	  to a coherent interconnect.

	  If a Cortex-A53 processor is executing a store or prefetch for
	  write instruction at the same time as a processor in another
	  cluster is executing a cache maintenance operation to the same
	  address, then this erratum might cause a clean cache line to be
	  incorrectly marked as dirty.

	  The workaround promotes data cache clean instructions to
	  data cache clean-and-invalidate.
	  Please note that this option does not necessarily enable the
	  workaround, as it depends on the alternative framework, which will
	  only patch the kernel if an affected CPU is detected.

	  If unsure, say Y.

config ARM64_ERRATUM_819472
	bool "Cortex-A53: 819472: Store exclusive instructions might cause data corruption"
	default y
	help
	  This option adds an alternative code sequence to work around ARM
	  erratum 819472 on Cortex-A53 parts up to r0p1 with an L2 cache
	  present when it is connected to a coherent interconnect.

	  If the processor is executing a load and store exclusive sequence at
	  the same time as a processor in another cluster is executing a cache
	  maintenance operation to the same address, then this erratum might
	  cause data corruption.

	  The workaround promotes data cache clean instructions to
	  data cache clean-and-invalidate.
	  Please note that this does not necessarily enable the workaround,
	  as it depends on the alternative framework, which will only patch
	  the kernel if an affected CPU is detected.

	  If unsure, say Y.

config ARM64_ERRATUM_832075
	bool "Cortex-A57: 832075: possible deadlock on mixing exclusive memory accesses with device loads"
	default y
	help
	  This option adds an alternative code sequence to work around ARM
	  erratum 832075 on Cortex-A57 parts up to r1p2.

	  Affected Cortex-A57 parts might deadlock when exclusive load/store
	  instructions to Write-Back memory are mixed with Device loads.

	  The workaround is to promote device loads to use Load-Acquire
	  semantics.
	  Please note that this does not necessarily enable the workaround,
	  as it depends on the alternative framework, which will only patch
	  the kernel if an affected CPU is detected.

	  If unsure, say Y.

config ARM64_ERRATUM_845719
	bool "Cortex-A53: 845719: a load might read incorrect data"
	depends on COMPAT
	default y
	help
	  This option adds an alternative code sequence to work around ARM
	  erratum 845719 on Cortex-A53 parts up to r0p4.

	  When running a compat (AArch32) userspace on an affected Cortex-A53
	  part, a load at EL0 from a virtual address that matches the bottom 32
	  bits of the virtual address used by a recent load at (AArch64) EL1
	  might return incorrect data.

	  The workaround is to write the contextidr_el1 register on exception
	  return to a 32-bit task.
	  Please note that this does not necessarily enable the workaround,
	  as it depends on the alternative framework, which will only patch
	  the kernel if an affected CPU is detected.

	  If unsure, say Y.

config CAVIUM_ERRATUM_23154
	bool "Cavium erratum 23154: Access to ICC_IAR1_EL1 is not sync'ed"
	depends on ARCH_THUNDER
	default y
	help
	  The gicv3 of ThunderX requires a modified version for
	  reading the IAR status to ensure data synchronization
	  (access to icc_iar1_el1 is not sync'ed before and after).

	  If unsure, say Y.

config CAVIUM_ERRATUM_27456
	bool "Cavium erratum 27456: Broadcast TLBI instructions may cause icache corruption"
	default y
	help
	  On ThunderX T88 pass 1.x through 2.1 parts, broadcast TLBI
	  instructions may cause the icache to become corrupted if it
	  contains data for a non-current ASID.  The fix is to
	  invalidate the icache when changing the mm context.

	  If unsure, say Y.

endmenu

config CPU_BIG_ENDIAN
	bool "Build big-endian kernel"
	help
	  Say Y if you plan on running a kernel in big-endian mode.
	  Note that your board must be properly built and your board
	  port must properly enable any big-endian related features
	  of your chipset/board/processor.

config OPTIMIZE_MANY_CPUS
	bool "Optimize for large numbers of CPUs"
	help
	  Say Y here if you have a system with a large number (>32 or so)
	  of CPUs.  This will apply optimizations that improve performance
	  in that scenario.

choice
	prompt "Page size"
	default ARM64_4K_PAGES
	help
	  Page size (translation granule) configuration.

config ARM64_4K_PAGES
	bool "4KB"
	help
	  This feature enables 4KB pages support.

config ARM64_64K_PAGES
	bool "64KB"
	help
	  This feature enables 64KB pages support (4KB by default)
	  allowing only two levels of page tables and faster TLB
	  look-up. AArch32 emulation is not available when this feature
	  is enabled.

endchoice

choice
	prompt "Virtual address space size"
	default ARM64_VA_BITS_39 if ARM64_4K_PAGES
	default ARM64_VA_BITS_42 if ARM64_64K_PAGES
	help
	  Allows choosing one of multiple possible virtual address
	  space sizes. The level of translation table is determined by
	  a combination of page size and virtual address space size.

config ARM64_VA_BITS_39
	bool "39-bit"
	depends on ARM64_4K_PAGES

config ARM64_VA_BITS_42
	bool "42-bit"
	depends on ARM64_64K_PAGES

config ARM64_VA_BITS_48
	bool "48-bit"
	depends on ARM64_4K_PAGES

endchoice

config ARM64_VA_BITS
	int
	default 39 if ARM64_VA_BITS_39
	default 42 if ARM64_VA_BITS_42
	default 48 if ARM64_VA_BITS_48

config ARM64_PGTABLE_LEVELS
	int
	default 2 if ARM64_64K_PAGES && ARM64_VA_BITS_42
	default 3 if ARM64_4K_PAGES && ARM64_VA_BITS_39
	default 4 if ARM64_4K_PAGES && ARM64_VA_BITS_48

config SMP
	bool "Symmetric Multi-Processing"
	select USE_GENERIC_SMP_HELPERS
	help
	  This enables support for systems with more than one CPU.  If
	  you say N here, the kernel will run on single and
	  multiprocessor machines, but will use only one CPU of a
	  multiprocessor machine. If you say Y here, the kernel will run
	  on many, but not all, single processor machines. On a single
	  processor machine, the kernel will run faster if you say N
	  here.

	  If you don't know what to do here, say N.

config NR_CPUS
	int "Maximum number of CPUs (2-4096)"
	range 2 4096
	depends on SMP
	default "8" if ARCH_XGENE
	default "48" if ARCH_THUNDER
	default "4"

config HOTPLUG_CPU
	bool "Support for hot-pluggable CPUs"
	depends on SMP
	help
	  Say Y here to experiment with turning CPUs off and on.  CPUs
	  can be controlled through /sys/devices/system/cpu.

source kernel/Kconfig.preempt

config HZ
	int
	default 20 if (ARCH_ARMADA_8K)
	default 100

config ARCH_HAS_HOLES_MEMORYMODEL
	def_bool y if SPARSEMEM

config ARCH_SPARSEMEM_ENABLE
	def_bool y
	select SPARSEMEM_VMEMMAP_ENABLE

config ARCH_SPARSEMEM_DEFAULT
	def_bool ARCH_SPARSEMEM_ENABLE

config ARCH_SELECT_MEMORY_MODEL
	def_bool ARCH_SPARSEMEM_ENABLE

config HAVE_ARCH_PFN_VALID
	def_bool ARCH_HAS_HOLES_MEMORYMODEL || !SPARSEMEM

config HW_PERF_EVENTS
	bool "Enable hardware performance counter support for perf events"
	depends on PERF_EVENTS
	default y
	help
	  Enable hardware performance counter support for perf events. If
	  disabled, perf events will use software events only.

config PMU_USERSPACE_ACCESS_ENABLE
	bool "Enable access from userspace to PMU counters"
	depends on HW_PERF_EVENTS
	default n
	help
	  Enable access from userspace to PMU counters

config MVEBU_SPMU
	depends on ARCH_MVEBU
	bool "Armada-8K SPMU Support"
	default y
	help
	  Enable system PMU for armada-8k SoCs.

config SYS_SUPPORTS_HUGETLBFS
	def_bool y

config ARCH_WANT_GENERAL_HUGETLB
	def_bool y

config ARCH_WANT_HUGE_PMD_SHARE
	def_bool y if !ARM64_64K_PAGES

config HAVE_ARCH_TRANSPARENT_HUGEPAGE
	def_bool y

source "mm/Kconfig"

config FORCE_MAX_ZONEORDER
	int
	default "14" if ((ARM64_64K_PAGES && TRANSPARENT_HUGEPAGE) || ARCH_MVEBU)
	default "13" if (ARCH_THUNDER && !ARM64_64K_PAGES)
	default "11"

config XGENE_WFE_ERRATA
	bool "Xgene wfe errata workaround"
	depends on ARCH_XGENE
	default n
	help
	  Workaround for Xgene WFE instruction errata that exists in earlier
	  version of the chip.

endmenu

menu "Boot options"

config CMDLINE
	string "Default kernel command string"
	default ""
	help
	  Provide a set of default command-line options at build time by
	  entering them here. As a minimum, you should specify the the
	  root device (e.g. root=/dev/nfs).

config CMDLINE_FORCE
	bool "Always use the default kernel command string"
	help
	  Always use the default kernel command string, even if the boot
	  loader passes other arguments to the kernel.
	  This is useful if you cannot or don't want to change the
	  command-line options your boot loader passes to the kernel.

endmenu

menu "Userspace binary formats"

source "fs/Kconfig.binfmt"

config COMPAT
	def_bool y
	depends on AARCH32_EL0 || ARM64_ILP32
	select COMPAT_BINFMT_ELF

config AARCH32_EL0
	bool "Kernel support for 32-bit EL0"
	depends on !ARM64_64K_PAGES
	select HAVE_UID16
	select OLD_SIGSUSPEND3
	select COMPAT_OLD_SIGACTION
	help
	  This option enables support for a 32-bit EL0 running under a 64-bit
	  kernel at EL1. AArch32-specific components such as system calls,
	  the user helper functions, VFP support and the ptrace interface are
	  handled appropriately by the kernel.

	  If you want to execute 32-bit userspace applications, say Y.

config ARM64_ILP32
	bool "Kernel support for ILP32"
	help
	  This option enables support for AArch64 ILP32 user space.  ILP32
	  is an ABI where long and pointers are 32bits but it uses the AARCH64
	  instruction set.

config SYSVIPC_COMPAT
	def_bool y
	depends on AARCH32_EL0 && SYSVIPC

endmenu

source "net/Kconfig"

source "drivers/Kconfig"

source "fs/Kconfig"

source "arch/arm64/Kconfig.debug"

source "security/Kconfig"

source "crypto/Kconfig"
if CRYPTO
source "arch/arm64/crypto/Kconfig"
endif

source "lib/Kconfig"
```
