## Documentation/devicetree/bindings/clock/bcm-iproc-clock.txt
```
Broadcom iProc family clocks

This binding uses the common clock binding:
Documentation/devicetree/bindings/clock/clock-bindings.txt

The iProc clock controller manages clocks that are common to the iProc family
of SoCs. The main PLL controlled is the ARM PLL which is derived from a 25
MHz crystal.

Required properties:
- compatible:
	Must be "brcm,iproc-arm-pll"

- #clock-cells:
	Must be <0>

- reg:
	Define the base and range of the I/O address space that contains the
	iProc clock control registers

- clocks:
	The input parent clock phandle for the PLL. For the iProc ARM PLL,
	this is a onboard crystal with a fixed rate

Example:

	osc: oscillator {
		#clock-cells = <0>;
		compatible = "fixed-clock";
		clock-frequency = <25000000>;
	};

	/* iProc ARM PLL */
	arm_pll: arm_pll {
		#clock-cells = <0>;
		compatible = "brcm,iproc-arm-pll";
		clocks = <&osc>;
		reg = <0x19000000 0x1000>;
	};

	/* peripheral clock for system timer */
	arm_periph_clk: arm_periph_clk {
		#clock-cells = <0>;
		compatible = "fixed-factor-clock";
		clocks = <&arm_pll>;
		clock-div = <2>;
		clock-mult = <1>;
	};

	asiu_clks: asiu_clks {
		#clock-cells = <1>;
		compatible = "brcm,cygnus-asiu-clk";
		reg = <0x0301d048 0xc>,
			<0x180aa024 0x4>;
		clocks = <&osc>;
		clock-output-names = "keypad", "adc/touch", "pwm";
	};


Northstar 2
-----------
PLL and leaf clock compatible strings for Northstar 2 are:
    "brcm,ns2-genpll-scr"
    "brcm,ns2-genpll-scr-clk"
    "brcm,ns2-genpll-sw"
    "brcm,ns2-genpll-sw-clk"
    "brcm,ns2-lcpll-ddr"
    "brcm,ns2-lcpll-ddr-clk"
    "brcm,ns2-lcpll-ports"
    "brcm,ns2-lcpll-ports-clk"

The following table defines the set of PLL/clock index and ID for Northstar 2.
These clock IDs are defined in:
    "include/dt-bindings/clock/bcm-ns2.h"

    Clock	Source		Index	ID
    ---		-----		-----	---------
    crystal	N/A		N/A	N/A

    genpll_scr	crystal		N/A	N/A
    genpll_sw	crystal		N/A	N/A
    lcpll_ddr	crystal		N/A	N/A
    lcpll_ddr	crystal		N/A	N/A

    scr		genpll_scr	0	BCM_NS2_GENPLL_SCR_SCR_CLK
    fs		genpll_scr	1	BCM_NS2_GENPLL_SCR_FS_CLK
    audio_ref	genpll_scr	2	BCM_NS2_GENPLL_SCR_AUDIO_CLK
    unused1	genpll_scr	3	BCM_NS2_GENPLL_SCR_UNUSED3
    unused2	genpll_scr	4	BCM_NS2_GENPLL_SCR_UNUSED4
    unused3	genpll_scr	5	BCM_NS2_GENPLL_SCR_UNUSED5

    rpe		genpll_sw	0	BCM_NS2_GENPLL_SW_RPE_CLK
    250		genpll_sw	1	BCM_NS2_GENPLL_SW_250_CLK
    nic		genpll_sw	2	BCM_NS2_GENPLL_SW_NIC_CLK
    chimp	genpll_sw	3	BCM_NS2_GENPLL_SW_CHIMP_CLK
    port	genpll_sw	4	BCM_NS2_GENPLL_SW_PORT_CLK
    sdio	genpll_sw	5	BCM_NS2_GENPLL_SW_SDIO_CLK

    pcie_sata_usb lcpll_ddr	0	BCM_NS2_LCPLL_DDR_PCIE_SATA_USB_CLK
    ddr		lcpll_ddr	1	BCM_NS2_LCPLL_DDR_DDR_CLK
    unused4	lcpll_ddr	2	BCM_NS2_LCPLL_DDR_UNUSED2
    unused5	lcpll_ddr	3	BCM_NS2_LCPLL_DDR_UNUSED3
    unused6	lcpll_ddr	4	BCM_NS2_LCPLL_DDR_UNUSED4
    unused7	lcpll_ddr	5	BCM_NS2_LCPLL_DDR_UNUSED5

    wan		lcpll_ports	0	BCM_NS2_LCPLL_PORTS_WAN_CLK
    rgmii	lcpll_ports	1	BCM_NS2_LCPLL_PORTS_RGMII_CLK
    unused8	lcpll_ports	2	BCM_NS2_LCPLL_PORTS_UNUSED2
    unused9	lcpll_ports	3	BCM_NS2_LCPLL_PORTS_UNUSED3
    unused10	lcpll_ports	4	BCM_NS2_LCPLL_PORTS_UNUSED4
    unused11	lcpll_ports	5	BCM_NS2_LCPLL_PORTS_UNUSED5
```

## Documentation/devicetree/bindings/clock/mvebu-armada8k-clock.txt
```
* Clock bindings for Marvell MVEBU Armada8K SoCs

Marvell MVEBU Armada 8K SoCs usually allow to determine clock frequencies by
reading the Sample-At-Reset (SAR) register. The clocks consumer should
specify the desired clock by having the clock ID in its "clocks" phandle cell.

The following is a list of provided IDs and clock names on Armada APN 806:
 0 = DDR
 1 = Ring
 2 = CPU
 3 = PIDI AP
 4 = PIDI AP

The following is a list of provided IDs and clock names on Armada APN 806 RING dividers:
 0 = Ring 0
 1 = Ring 2
 2 = Ring 3
 3 = Ring 4
 4 = Ring 5

Required properties:
- compatible : shall be one of the following:
	"marvell,armada-apn806-clock" - For Armada Armada APN 806 clocks
	"marvell,armada-apn806-ring-clock" - For Armada Armada APN 806 RING clocks dividers
- reg : shall be the register address of the Sample-At-Reset (SAR) register
- #clock-cells : from common clock binding; shall be set to 1

Example:

ap806clk: device-sar@0x6F8200 {
	compatible = "marvell,armada-apn806-clock";
	reg = <0x6F8204 0x04>;
	#clock-cells = <1>;
};

ringclk: server-control@0x6F8250 {
	compatible = "marvell,armada-apn806-ring-clock";
	reg = <0x6F8250 0x04>;
	#clock-cells = <1>;
	clocks = <&ap806clk 1>;

};

serial@512100 {
	compatible = "snps,dw-apb-uart";
	reg = <0x512100 0x100>;
	clock-frequency = <25000000>;
	reg-shift = <2>;
	interrupts = <GIC_SPI 29 IRQ_TYPE_LEVEL_HIGH>;
	reg-io-width = <1>;
	clocks = <&ringclk 2>;
};
```

## Documentation/devicetree/bindings/net/broadcom-amac.txt
```
Broadcom AMAC Ethernet Switch Controller Device Tree Bindings
-------------------------------------------------------------

Required properties:
	- compatible: Should be "brcm,amac-enet"
	- reg       : Physical base address and size of the
                      ethernet registers
	- interrupts: AMAC Interrupt number

Optional properties:
	- switchmode: Switch mode (0: Switch bypass mode, 1: Switch mode)
                      The switch mode is defaulted to 'Switch mode'.
                      In the Switch bypass mode, only Port 0 will be enabled.
	- tag_support: Adds support for handling tags in the driver in the
                       switch mode
                       0 - No tag support
		       1 - BRCM tag support

Required Child Node(s):
Port information is read via child nodes. Atleast one child node is required.
If the switch is disabled (switchmode=0), only the node with port-id=0 will be
used.
	- port-id   : Port number (0, 1 etc.).
                      port-id has to be '0' when switchmode=0.
	- phy-id    : Phy id associated with the port (0, 1, etc)
	- port-type : Port type (0 - LAN port, 1 - PC port)
                      LAN Ports have PAUSE frames disabled.
                      Link status is reported based on LAN port, if available.
                      PC Ports are regular Ethernet ports.
 Optional property:
 	- speed     : Max speed of the Port (1000 or 100)
 			Default value of the port speed is 1000 or 1G.


Examples:
1. Port0 is LAN and Port1 is PC port in Switch mode (with BRCM tag support):

	enet: enet@0x18042000 {
		compatible = "brcm,amac-enet";
		reg = core_regs: <0x18042000 0x1000>,
			amac_io_ctrl: <0x18110408 0x10>,
			amac_idm_reset: <0x18110800 0x4>,
			mii_mgmt_ctrl_regs: <0x18002000 0x4>,
			mii_cmd_data_regs: <0x18002004 0x4>,
			icfg_regs: <0x18000000 0x1000>,
			chip_dru_base: <0x0301d000 0x1000>,
			srab_base: <0x18007000 0x1000>;
		interrupts = <GIC_SPI 110 IRQ_TYPE_LEVEL_HIGH>;
		switchmode = <1>;
		tag_support = <1>;
		status="okay";

		port@0 {
			port-id = <0>;
			port-type = <0>;
			phy-id = <0>;
		};

		port@1 {
			port-id = <1>;
			port-type = <1>;
			phy-id = <1>;
		};
	};

(or)
2. Port0 is LAN in Switch bypass mode:

	enet: enet@0x18042000 {
		compatible = "brcm,amac-enet";
		reg = core_regs: <0x18042000 0x1000>,
			amac_io_ctrl: <0x18110408 0x10>,
			amac_idm_reset: <0x18110800 0x4>,
			mii_mgmt_ctrl_regs: <0x18002000 0x4>,
			mii_cmd_data_regs: <0x18002004 0x4>,
			icfg_regs: <0x18000000 0x1000>,
			chip_dru_base: <0x0301d000 0x1000>,
			srab_base: <0x18007000 0x1000>;
		interrupts = <GIC_SPI 110 IRQ_TYPE_LEVEL_HIGH>;
		switchmode = <0>;
		tag_support = <0>;
		status="okay";

		port@0 {
			port-id = <0>;
			port-type = <0>;
			phy-id = <0>;
		};
	};

(or)
3. Port0 is PC and Port1 is LAN port in Switch mode (no tag support):

	enet: enet@0x18042000 {
		compatible = "brcm,amac-enet";
		reg = core_regs: <0x18042000 0x1000>,
			amac_io_ctrl: <0x18110408 0x10>,
			amac_idm_reset: <0x18110800 0x4>,
			mii_mgmt_ctrl_regs: <0x18002000 0x4>,
			mii_cmd_data_regs: <0x18002004 0x4>,
			icfg_regs: <0x18000000 0x1000>,
			chip_dru_base: <0x0301d000 0x1000>,
			srab_base: <0x18007000 0x1000>;
		interrupts = <GIC_SPI 110 IRQ_TYPE_LEVEL_HIGH>;
		switchmode = <1>;
		tag_support = <0>;
		status="okay";

		port@0 {
			port-id = <0>;
			port-type = <1>;
			phy-id = <0>;
		};

		port@1 {
			port-id = <1>;
			port-type = <0>;
			phy-id = <1>;
		};
	};

(or)
4. Port0 is LAN and Port1 is PC port in Switch mode (no tag support):
   Port0 has a max speed of 100M

	enet: enet@0x18042000 {
		compatible = "brcm,amac-enet";
		reg = core_regs: <0x18042000 0x1000>,
			amac_io_ctrl: <0x18110408 0x10>,
			amac_idm_reset: <0x18110800 0x4>,
			mii_mgmt_ctrl_regs: <0x18002000 0x4>,
			mii_cmd_data_regs: <0x18002004 0x4>,
			icfg_regs: <0x18000000 0x1000>,
			chip_dru_base: <0x0301d000 0x1000>,
			srab_base: <0x18007000 0x1000>;
		interrupts = <GIC_SPI 110 IRQ_TYPE_LEVEL_HIGH>;
		switchmode = <1>;
		tag_support = <0>;
		status="okay";

		port@0 {
			port-id = <0>;
			port-type = <1>;
			phy-id = <0>;
			speed = <100>;
		};

		port@1 {
			port-id = <1>;
			port-type = <0>;
			phy-id = <1>;
		};
	};
```

## Documentation/devicetree/bindings/phy/brcm,phy-bcm-ns2-sata.txt
```
Broadcom NorthStar2 SATA PHY

Required properties:
- compatible: Must be "brcm,ns2-sata-phy"
- reg :	SATA IDM space (see note below)
	SATA host space (SATA_ROOT in the regs file)

Note: The SATA IDM space is not given an explicit beginning in the regs
file.  The easiest way to get it is to zero the lower three nybbles of
SATA_M0_IDM_IDM_IO_CONTROL_DIRECT.

Example: (assumes platform uses 2 'cells' for both address and length)
	sata_phy: sata_phy@0x00000000633F0000 {
		compatible = "brcm,ns2-sata-phy";
			reg = <0x00000000 0x67004000 0x00000000 0x00001000>,
			      <0x00000000 0x633F0000 0x00000000 0x00004000>;
	};
```

## Documentation/devicetree/bindings/pinctrl/brcm,northstar2-pinmux.txt
```
Broadcom Northstar2 IOMUX Controller

The Northstar2 IOMUX controller supports group based mux configuration. In
addition, certain pins can be muxed to GPIO function individually.

Required properties:

- compatible:
    Must be "brcm,northstar2-pinmux"

- reg:
    Define the base and range of the I/O address space that contains the Northstar2
IOMUX registers

Required properties in child nodes:

- function:
    The mux function to select

- groups:
    The list of groups to select with a given function

Each child node represents a configuration. Client devices reference the child
node to enable a mux configuration

For more details, refer to
Documentation/devicetree/bindings/pinctrl/pinctrl-bindings.txt

For example:

	pinmux: pinmux@0x0301d0c8 {
		compatible = "brcm,northstar2-pinmux";
		reg = <0x0301d0c8 0x1b0>;

		i2s_0: i2s_0 {
			function = "i2s0";
			groups = "i2s0_0_grp", "i2s0_1_grp";
		};

		i2s_1: i2s_1 {
			function = "i2s1";
			groups = "i2s1_0_grp", "i2s1_1_grp";
		};

		i2s_2: i2s_2 {
			function = "i2s2";
			groups = "i2s2_0_grp", "i2s2_1_grp", "i2s2_2_grp",
				 "i2s2_3_grp", "i2s2_4_grp";
		};

		spi_0: spi_0 {
			function = "spi0";
			groups = "spi0_grp";
		};
	}

	spi0@18028000 {
			compatible = "arm,pl022", "arm,primecell";
			reg = <0x18028000 0x1000>;
			#address-cells = <1>;
			#size-cells = <0>;
			interrupts = <GIC_SPI 78 IRQ_TYPE_LEVEL_HIGH>;
			pinctrl-0 = <&spi_0>;
			clocks = <&axi81_clk>;
			clock-names = "apb_pclk";
	};

List of supported functions and groups in Northstar2:
```

## Documentation/devicetree/bindings/power_supply/iproc-reboot.txt
```
* iProc Reboot

Northstar and Northstar Plus hardware has a "Device Management Unit", which can
be programmed to reset the boards.

Required Properties:
- compatible: Should be "brcm,iproc-reboot"
- reg: Address and length of the register set for the DMU
```

## Documentation/devicetree/bindings/usb/bcm-ns2-usb2-phy.txt
```
BROADCOM Northstar2 USB2 PHY

Required properties:
 - compatible: "brcm,ns2-usb2-phy"
 - reg: address of each of the below PHY registers for the given controller.
       idm_reset_ctl
       idm_io_ctl_direct
       crmu_usb2_ctl
       ohci_ehci_strap
       phy_ctrl_p0
       phy_misc_status
       icfg_fsm
 - afe_corerdy_vddc: position within crmu_usb2_ctl of afe_corerdy_vddc bit
   for the specifie controller.
 - #phy-cells: must be 1 to enable both EHCI and OHCI cores.

Optional properties:
- enable-dual-role: define for dual-role-device ports

Refer to phy/phy-bindings.txt for the generic PHY binding properties

Example:


	usbphy0: usbphy@0x67010800 {
		#phy-cells = <1>;
		compatible = "brcm,ns2-usb2-phy";
		reg = m0_idm_reset_ctl:  <0x67010800 0x4>,
		   m0_idm_io_ctl_direct: <0x67010408 0x4>,
		   m0_crmu_usb2_ctl:     <0x6501D148 0x4>,
		   m0_ohci_ehci_strap:   <0x66490700 0x4>,
                   m0_phy_ctrl_p0:       <0x66490200 0x4>,
		   m0_phy_misc_status:   <0x66000888 0x4>;
		   m0_icfg_fsm:          <0x66000984 0x4>;
		   afe_corerdy_vddc = <13>;
	};
```

## Documentation/devicetree/bindings/watchdog/arm,sp805.txt
```
ARM sp805 watchdog
-------------------------------------
Required properties:
- compatible: Should be "arm,sp805" & "arm,primecell"
- reg: Should contain location and length for watchdog timer register.
- interrupts: Should contain the list of Watchdog Timer interrupts.
- clocks: clocks driving the watchdog timer hardware. This list should be 2
	clocks. With 2 clocks, the order is wdogclk clock, apb_pclk.
	A single clock can also be specified if the same clock is used for all
	clock inputs.

Example:
		wdt@66090000 {
			compatible = "arm,sp805", "arm,primecell";
			reg = <0x66090000 0x1000>;
			interrupts = <GIC_SPI 406 IRQ_TYPE_LEVEL_HIGH>;
			clocks = <&apb_pclk>,<&apb_pclk>;
			clock-names = "wdogclk", "apb_pclk";
		};
```
